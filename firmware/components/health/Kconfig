## firmware/components/health/Kconfig
```kconfig
menu "Deck health"

    config DECK_DIAGNOSTIC_CONSOLE
        bool "Emit development diagnostics on the console"
        default n
        help
            Emit machine-readable JSON Lines diagnostics for development and
            hardware-in-loop tests. Production configurations must leave this
            disabled so diagnostics never enter the future Target bridge.

endmenu
```

## firmware/components/serial_service/Kconfig
```kconfig
menu "Serial service"

config DECK_SERIAL_HISTORY_KIB
    int "Current Serial Session history size (KiB)"
    range 64 2048
    default 512
    help
        PSRAM payload capacity retained for the current Serial Session only.
        Router metadata and sink indices are allocated separately in PSRAM.

endmenu
```

## firmware/components/setup_mode/Kconfig
```kconfig
menu "Deck Setup Mode"

config DECK_SETUP_INACTIVITY_TIMEOUT_SECONDS
    int "Setup Mode inactivity timeout in seconds"
    range 10 3600
    default 600
    help
        Stop the ephemeral AP and HTTP recovery page after this many seconds
        without a handled page, status, or scan request.

config DECK_WIFI_VALIDATION_TIMEOUT_SECONDS
    int "Wi-Fi validation timeout in seconds"
    range 10 120
    default 20
    help
        Allow station association and DHCP to complete before rejecting a
        candidate or declaring a stored active network unreachable. This is
        independent of the shorter development-only Setup inactivity timeout.

endmenu
```
